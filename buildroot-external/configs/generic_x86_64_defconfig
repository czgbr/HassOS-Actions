## buildroot-external/configs/generic_x86_64_defconfig
```kconfig
BR2_TARGET_ZONELIST=\"default\"
BR2_TARGET_LOCALTIME=\"Asia/Shanghai\"
#------------------------------------
BR2_HOST_LZO=n
BR2_USE_MMU=y
BR2_USE_WCHAR=y
BR2_PACKAGE_PKGCONF=y
BR2_TOOLCHAIN_HAS_SSP=y
BR2_TOOLCHAIN_HAS_THREADS=y
BR2_TOOLCHAIN_HAS_UCONTEXT=y
BR2_TOOLCHAIN_SUPPORTS_PIE=y
BR2_TOOLCHAIN_HAS_SSP_STRONG=y
BR2_TOOLCHAIN_HAS_NATIVE_RPC=y
BR2_TOOLCHAIN_HAS_THREADS_DEBUG=y
BR2_TOOLCHAIN_HAS_THREADS_NPTL=y
BR2_TOOLCHAIN_EXTERNAL_CXX=y
BR2_TOOLCHAIN_EXTERNAL_WCHAR=y
BR2_TOOLCHAIN_EXTERNAL_LOCALE=y
BR2_TOOLCHAIN_EXTERNAL_HAS_SSP=y
BR2_TOOLCHAIN_EXTERNAL_INET_RPC=y
BR2_TOOLCHAIN_EXTERNAL_HAS_THREADS=y
BR2_TOOLCHAIN_EXTERNAL_HAS_SSP_STRONG=y
BR2_TOOLCHAIN_EXTERNAL_HAS_THREADS_NPTL=y
BR2_TOOLCHAIN_EXTERNAL_HAS_THREADS_DEBUG=y
BR2_TOOLCHAIN_BUILDROOT_CXX=y
BR2_TOOLCHAIN_HAS_FULL_GETTEXT=y
#BR2_INSTALL_LIBSTDCPP=y
#BR2_PACKAGE_CLANG=y
#BR2_PACKAGE_LLVM_ARCH_SUPPORTS=y
#BR2_PACKAGE_LIBXML2=y
#BR2_PACKAGE_LLVM=y
#------------------------------------
BR2_TARGET_ENABLE_ROOT_LOGIN=y
BR2_ROOTFS_SKELETON_DEFAULT=y
BR2_TARGET_GENERIC_ROOT_PASSWD=\"zhirui02\"
#------------------------------------
BR2_TARGET_INFO=y
#BR2_PACKAGE_HTOP=y
BR2_PACKAGE_VIM=y
#BR2_PACKAGE_WGET=y
#BR2_PACKAGE_MAKE=y
BR2_PACKAGE_NANO_TINY=y
BR2_PACKAGE_HOST_ZIP=y
#------------------------------------
#BR2_PACKAGE_RPM=y
#BR2_PACKAGE_BUSYBOX_SHOW_OTHERS=y
#BR2_PACKAGE_LUA=y
#BR2_PACKAGE_LUA_5_4=y
#BR2_PACKAGE_FILE=y
#BR2_PACKAGE_POPT=y
#------------------------------------
#BR2_PACKAGE_GIT=y
#BR2_PACKAGE_ZLIB_NG_ARCH_SUPPORTS=y
#BR2_PACKAGE_ZLIB=y
#BR2_PACKAGE_LIBZLIB=y
#BR2_PACKAGE_HAS_ZLIB=y
#BR2_PACKAGE_PROVIDES_ZLIB="libzlib"
#BR2_PACKAGE_PROVIDES_HOST_ZLIB="host-libzlib"
#------------------------------------
#BR2_PACKAGE_NTP=y
#BR2_PACKAGE_NTP_SNTP=y
#BR2_PACKAGE_NTPDATE=y
#BR2_PACKAGE_NTPTIME=y
#BR2_PACKAGE_TZDATA=y
#------------------------------------
#BR2_PACKAGE_PYTHON3=y
#BR2_PACKAGE_PYTHON3_PYC_ONLY=y
#BR2_PACKAGE_PYTHON3_UNICODEDATA=y
#------------------------------------
#BR2_PACKAGE_QT5_JSCORE_AVAILABLE=y
#BR2_PACKAGE_QT5=y
#BR2_PACKAGE_QT5BASE=y
#BR2_PACKAGE_QT5BASE_CUSTOM_CONF_OPTS=""
#BR2_PACKAGE_QT5BASE_CONFIG_FILE=""
#BR2_PACKAGE_QT5BASE_NETWORK=y
#BR2_PACKAGE_QT5BASE_SQL=y
#BR2_PACKAGE_QT5BASE_SQLITE_NONE=y
#BR2_PACKAGE_QT5BASE_TEST=y
#BR2_PACKAGE_QT5BASE_XML=y
#BR2_PACKAGE_QT5BASE_GUI=y
#BR2_PACKAGE_QT5BASE_WIDGETS=y
#BR2_PACKAGE_QT5BASE_LINUXFB=y
#BR2_PACKAGE_QT5BASE_DEFAULT_QPA=""
#BR2_PACKAGE_QT5BASE_PRINTSUPPORT=y
#BR2_PACKAGE_QT5BASE_GIF=y
#BR2_PACKAGE_QT5BASE_JPEG=y
#BR2_PACKAGE_QT5BASE_PNG=y
#BR2_PACKAGE_QT5BASE_ICU=y
#BR2_PACKAGE_QT5BASE_TSLIB=y
#BR2_PACKAGE_QT5LOCATION=y
#BR2_PACKAGE_QT5SENSORS=y
#BR2_PACKAGE_QT5WEBCHANNEL=y
#BR2_PACKAGE_QT5WEBKIT=y
#BR2_PACKAGE_QT5WEBENGINE_ARCH_SUPPORTS=y
#BR2_PACKAGE_QT5WEBSOCKETS=y
#------------------------------------
BR2_PACKAGE_OPENSSL=y
BR2_PACKAGE_LIBOPENSSL=y
BR2_PACKAGE_OPENSSH=y
BR2_PACKAGE_OPENSSH_CLIENT=no
BR2_PACKAGE_OPENSSH_SERVER=y
BR2_PACKAGE_OPENSSH_SANDBOX=no
BR2_PACKAGE_OPENSSH_KEY_UTILS=y
#------------------------------------
#BR2_PACKAGE_OPKG=y
#BR2_PACKAGE_OPKG_UTILS=y
#BR2_PACKAGE_OPKG_GPG_SIGN=y
#BR2_PACKAGE_LIBARCHIVE=y
#BR2_PACKAGE_LIBFFI=y
#------------------------------------
BR2_PACKAGE_XORG7=y  
BR2_PACKAGE_XSERVER_XORG_SERVER=y  
BR2_PACKAGE_XSERVER_XORG_SERVER_MODULAR=y  
BR2_PACKAGE_XSERVER_XORG_SERVER_XVFB=y  
BR2_PACKAGE_XSERVER_XORG_SERVER_XEPHYR=y  
BR2_PACKAGE_LIBXCB=y  
BR2_PACKAGE_XLIB_LIBICE=y  
BR2_PACKAGE_XLIB_LIBSM=y  
BR2_PACKAGE_XLIB_LIBX11=y  
BR2_PACKAGE_XLIB_LIBXAU=y  
BR2_PACKAGE_XLIB_LIBXAW=y  
BR2_PACKAGE_XLIB_LIBXCOMPOSITE=y  
BR2_PACKAGE_XLIB_LIBXCURSOR=y  
BR2_PACKAGE_XLIB_LIBXDAMAGE=y  
BR2_PACKAGE_XLIB_LIBXDMCP=y  
BR2_PACKAGE_XLIB_LIBXEXT=y  
BR2_PACKAGE_XLIB_LIBXFIXES=y  
BR2_PACKAGE_XLIB_LIBXFONT2=y  
BR2_PACKAGE_XLIB_LIBXFT=y  
BR2_PACKAGE_XLIB_LIBXI=y  
BR2_PACKAGE_XLIB_LIBXINERAMA=y  
BR2_PACKAGE_XLIB_LIBXMU=y  
BR2_PACKAGE_XLIB_LIBXPM=y  
BR2_PACKAGE_XLIB_LIBXRANDR=y  
BR2_PACKAGE_XLIB_LIBXRENDER=y  
BR2_PACKAGE_XLIB_LIBXRES=y  
BR2_PACKAGE_XLIB_LIBXT=y  
BR2_PACKAGE_XLIB_LIBXTST=y  
BR2_PACKAGE_XLIB_LIBXV=y  
BR2_PACKAGE_XLIB_LIBXXF86VM=y  
BR2_PACKAGE_XLIB_LIBFONTENC=y  
BR2_PACKAGE_XLIB_LIBXCVT=y  
BR2_PACKAGE_XLIB_LIBXKBFILE=y  
BR2_PACKAGE_XLIB_LIBXSHMFENCE=y  
BR2_PACKAGE_XLIB_XTRANS=y  
BR2_PACKAGE_XAPP_XAUTH=y  
BR2_PACKAGE_XAPP_XHOST=y  
BR2_PACKAGE_XAPP_XINIT=y  
BR2_PACKAGE_XAPP_XKBCOMP=y  
BR2_PACKAGE_XAPP_XSET=y  
BR2_PACKAGE_XDRIVER_XF86_INPUT_MOUSE=y  
BR2_PACKAGE_XFONT_FONT_UTIL=y  
BR2_PACKAGE_XFONT_ENCODINGS=y  
BR2_PACKAGE_XFONT_FONT_ALIAS=y  
BR2_PACKAGE_XFONT_FONT_CURSOR_MISC=y  
BR2_PACKAGE_XFONT_FONT_MISC_MISC=y  
BR2_PACKAGE_XCB_PROTO=y  
BR2_PACKAGE_XORGPROTO=y  
BR2_PACKAGE_MCOOKIE=y  
BR2_PACKAGE_XDATA_XBITMAPS=y  
BR2_PACKAGE_XTERM=y  
BR2_PACKAGE_XVKBD=y  
BR2_PACKAGE_XKEYBOARD_CONFIG=y  
BR2_PACKAGE_XDRIVER_XF86_VIDEO_VESA=y
BR2_PACKAGE_XDRIVER_XF86_VIDEO_FBDEV=y
#BR2_PACKAGE_XDRIVER_XF86_INPUT_TSLIB=y
BR2_PACKAGE_MTDEV=y
BR2_PACKAGE_LIBEVDEV=y
BR2_PACKAGE_HAS_UDEV=y
BR2_PACKAGE_XDRIVER_XF86_INPUT_EVDEV=y
BR2_PACKAGE_XWAYLAND=y
BR2_PACKAGE_XLIB_LIBXSCRNSAVER=y
#------------------------------------
#BR2_PACKAGE_MATCHBOX=y  
#BR2_PACKAGE_MATCHBOX_SM=y  
#BR2_PACKAGE_MATCHBOX_COMMON=y  
#BR2_PACKAGE_MATCHBOX_COMMON_PDA=y  
#BR2_PACKAGE_MATCHBOX_DESKTOP=y  
#BR2_PACKAGE_MATCHBOX_FAKEKEY=y  
#BR2_PACKAGE_MATCHBOX_KEYBOARD=y  
#BR2_PACKAGE_MATCHBOX_LIB=y  
#BR2_PACKAGE_MATCHBOX_PANEL=y  
#BR2_PACKAGE_MATCHBOX_STARTUP_MONITOR=y  
#------------------------------------
BR2_PACKAGE_FBV=y
BR2_PACKAGE_FBGRAB=y
BR2_PACKAGE_FB_TEST_APP=y
#------------------------------------
BR2_PACKAGE_FFMPEG_ARCH_SUPPORTS=y
BR2_PACKAGE_KODI_ARCH_SUPPORTS=y
BR2_PACKAGE_KODI_PLATFORM_SUPPORTS=y
BR2_PACKAGE_KODI_PLATFORM_SUPPORTS_X11=y
BR2_PACKAGE_MJPEGTOOLS_SIMD_SUPPORT=y
BR2_PACKAGE_MPV_SUPPORTS_VAAPI=y
BR2_PACKAGE_PULSEAUDIO_HAS_ATOMIC=y
BR2_PACKAGE_BROTLI=y
BR2_PACKAGE_BPFTOOL_ARCH_SUPPORTS=y
BR2_PACKAGE_DELVE_ARCH_SUPPORTS=y
BR2_PACKAGE_FWTS_ARCH_SUPPORTS=y
BR2_PACKAGE_GDB_ARCH_SUPPORTS=y
BR2_PACKAGE_GOOGLE_BREAKPAD_ARCH_SUPPORTS=y
BR2_PACKAGE_KVM_UNIT_TESTS_ARCH_SUPPORTS=y
BR2_PACKAGE_LTP_TESTSUITE_ARCH_SUPPORTS=y
BR2_PACKAGE_LTRACE_ARCH_SUPPORTS=y
BR2_PACKAGE_OPROFILE_ARCH_SUPPORTS=y
BR2_PACKAGE_PERFTEST_ARCH_SUPPORTS=y
BR2_PACKAGE_PLY_ARCH_SUPPORTS=y
BR2_PACKAGE_TCF_AGENT_ARCH="x86_64"
BR2_PACKAGE_TCF_AGENT_ARCH_SUPPORTS=y
BR2_PACKAGE_TRINITY_ARCH_SUPPORTS=y
BR2_PACKAGE_UFTRACE_ARCH_SUPPORTS=y
BR2_PACKAGE_VALGRIND_ARCH_SUPPORTS=y
BR2_PACKAGE_CMAKE_ARCH_SUPPORTS=y
BR2_PACKAGE_PROVIDES_HOST_GETTEXT="host-gettext-tiny"
BR2_PACKAGE_GLMARK2_FLAVOR_ANY=y
BR2_PACKAGE_GLMARK2_FLAVOR_X11_GL=y
BR2_PACKAGE_MIDORI_ARCH_SUPPORTS=y
BR2_PACKAGE_MIDORI=y
BR2_PACKAGE_NETSURF_ARCH_SUPPORTS=y
BR2_PACKAGE_LIBGLVND=y
BR2_PACKAGE_LIBGLVND_DISPATCH_GL=y
BR2_PACKAGE_PROVIDES_LIBGL="libglvnd"
BR2_PACKAGE_MESA3D=y
BR2_PACKAGE_MESA3D_DRI3=y
BR2_PACKAGE_MESA3D_VULKAN_DRIVER=y
BR2_PACKAGE_MESA3D_DRIVER=y
BR2_PACKAGE_MESA3D_NEEDS_X11=y
BR2_PACKAGE_MESA3D_VULKAN_DRIVER_INTEL=y
BR2_PACKAGE_MESA3D_OPENGL_GLX=y
BR2_PACKAGE_QT5_GL_AVAILABLE=y
BR2_PACKAGE_QT5_JSCORE_AVAILABLE=y
BR2_PACKAGE_QT6_ARCH_SUPPORTS=y
BR2_PACKAGE_QT6_GL_SUPPORTS=y
BR2_PACKAGE_MCOOKIE=y
BR2_PACKAGE_XDATA_XBITMAPS=y
BR2_PACKAGE_VTE=y
BR2_PACKAGE_XKEYBOARD_CONFIG=y
BR2_PACKAGE_FLASHROM_ARCH_SUPPORTS=y
BR2_PACKAGE_SEDUTIL_ARCH_SUPPORTS=y
BR2_PACKAGE_HOST_ERLANG_ARCH_SUPPORTS=y
BR2_PACKAGE_ERLANG_ARCH_SUPPORTS=y
BR2_PACKAGE_GAUCHE_ARCH_SUPPORTS=y
BR2_PACKAGE_PROVIDES_HOST_LUAINTERPRETER="host-lua"
BR2_PACKAGE_LUAJIT_ARCH_SUPPORTS=y
BR2_PACKAGE_HOST_MONO_ARCH_SUPPORTS=y
BR2_PACKAGE_MONO_ARCH_SUPPORTS=y
BR2_PACKAGE_NODEJS_ARCH_SUPPORTS=y
BR2_PACKAGE_HOST_OPENJDK_BIN_ARCH_SUPPORTS=y
BR2_PACKAGE_OPENJDK_ARCH_SUPPORTS=y
BR2_PACKAGE_PHP_ARCH_SUPPORTS=y
BR2_PACKAGE_PYTHON3=y
BR2_PACKAGE_PYTHON3_PYC_ONLY=y
BR2_PACKAGE_PYTHON3_UNICODEDATA=y
BR2_PACKAGE_PYTHON_GREENLET_ARCH_SUPPORTS=y
BR2_PACKAGE_PYTHON_NUMPY_ARCH_SUPPORTS=y
BR2_PACKAGE_FDK_AAC_ARCH_SUPPORTS=y
BR2_PACKAGE_OPENAL_ARCH_SUPPORTS=y
BR2_PACKAGE_WEBRTC_AUDIO_PROCESSING_ARCH_SUPPORTS=y
BR2_PACKAGE_LIBARCHIVE=y
BR2_PACKAGE_ZLIB_NG_ARCH_SUPPORTS=y
BR2_PACKAGE_ZLIB=y
BR2_PACKAGE_LIBZLIB=y
BR2_PACKAGE_HAS_ZLIB=y
BR2_PACKAGE_PROVIDES_ZLIB="libzlib"
BR2_PACKAGE_PROVIDES_HOST_ZLIB="host-libzlib"
BR2_PACKAGE_BOTAN_ARCH_SUPPORTS=y
BR2_PACKAGE_GCR=y
BR2_PACKAGE_LIBASSUAN=y
BR2_PACKAGE_LIBGCRYPT=y
BR2_PACKAGE_LIBGPG_ERROR_ARCH_SUPPORTS=y
BR2_PACKAGE_LIBGPG_ERROR=y
BR2_PACKAGE_LIBGPG_ERROR_SYSCFG="x86_64-unknown-linux-gnu"
BR2_PACKAGE_LIBKSBA=y
BR2_PACKAGE_LIBSECRET=y
BR2_PACKAGE_PROVIDES_HOST_OPENSSL="host-libopenssl"
BR2_PACKAGE_MONGODB_ARCH_SUPPORTS=y
BR2_PACKAGE_ROCKSDB_ARCH_SUPPORTS=y
BR2_PACKAGE_SQLITE=y
BR2_PACKAGE_ATK=y
BR2_PACKAGE_CAIRO=y
BR2_PACKAGE_CAIRO_PS=y
BR2_PACKAGE_CAIRO_PDF=y
BR2_PACKAGE_CAIRO_PNG=y
BR2_PACKAGE_CAIRO_SVG=y
BR2_PACKAGE_FONTCONFIG=y
BR2_PACKAGE_FREETYPE=y
BR2_PACKAGE_GDK_PIXBUF=y
BR2_PACKAGE_GRANITE=y
BR2_PACKAGE_HARFBUZZ=y
BR2_PACKAGE_JPEG_SIMD_SUPPORT=y
BR2_PACKAGE_JPEG=y
BR2_PACKAGE_JPEG_TURBO=y
BR2_PACKAGE_HAS_JPEG=y
BR2_PACKAGE_PROVIDES_JPEG="jpeg-turbo"
BR2_PACKAGE_LIBDRM=y
BR2_PACKAGE_LIBDRM_HAS_ATOMIC=y
BR2_PACKAGE_LIBEPOXY=y
BR2_PACKAGE_LIBGTK3=y
BR2_PACKAGE_LIBGTK3_BROADWAY=y
BR2_PACKAGE_LIBGTK3_X11=y
BR2_PACKAGE_LIBPNG=y
BR2_PACKAGE_HAS_LIBGL=y
BR2_PACKAGE_OPENJPEG=y
BR2_PACKAGE_PANGO=y
BR2_PACKAGE_PIXMAN=y
BR2_PACKAGE_WAFFLE_SUPPORTS_GLX=y
BR2_PACKAGE_WEBKITGTK_ARCH_SUPPORTS=y
BR2_PACKAGE_WEBKITGTK=y
BR2_PACKAGE_WEBP=y
BR2_PACKAGE_WEBP_DEMUX=y
BR2_PACKAGE_WOFF2=y
BR2_PACKAGE_WPEWEBKIT_ARCH_SUPPORTS=y
BR2_PACKAGE_GNU_EFI_ARCH_SUPPORTS=y
BR2_PACKAGE_LIBPCIACCESS=y
BR2_PACKAGE_MRAA_ARCH_SUPPORTS=y
BR2_PACKAGE_EXPAT=y
BR2_PACKAGE_JSON_GLIB=y
BR2_PACKAGE_LIBXML2=y
BR2_PACKAGE_LIBXSLT=y
BR2_PACKAGE_LIBCAMERA_ARCH_SUPPORTS=y
BR2_PACKAGE_LIBOPENH264_ARCH_SUPPORTS=y
BR2_PACKAGE_LIBPSL=y
BR2_PACKAGE_LIBSOUP=y
BR2_PACKAGE_GOBJECT_INTROSPECTION_ARCH_SUPPORTS=y
BR2_PACKAGE_GOBJECT_INTROSPECTION=y
BR2_PACKAGE_JEMALLOC_ARCH_SUPPORTS=y
BR2_PACKAGE_LAPACK_ARCH_SUPPORTS=y
BR2_PACKAGE_LIBABSEIL_CPP_ARCH_SUPPORTS=y
BR2_PACKAGE_LIBATOMIC_OPS_ARCH_SUPPORTS=y
BR2_PACKAGE_LIBBSD_ARCH_SUPPORTS=y
BR2_PACKAGE_LIBEASTL_ARCH_SUPPORTS=y
BR2_PACKAGE_LIBFFI=y
BR2_PACKAGE_LIBGEE=y
BR2_PACKAGE_DBUS=y
BR2_PACKAGE_GETTEXT=y
BR2_PACKAGE_HAS_GETTEXT=y
BR2_PACKAGE_LIBGLIB2=y
BR2_PACKAGE_AT_SPI2_CORE=y
BR2_PACKAGE_AT_SPI2_ATK=y
BR2_PACKAGE_LIBNPTH=y
BR2_PACKAGE_LIBNSPR_ARCH_SUPPORT=y
BR2_PACKAGE_LIBPEAS=y
BR2_PACKAGE_LIBPEAS_WIDGETS=y
BR2_PACKAGE_LIBPTHREAD_STUBS=y
BR2_PACKAGE_LIBSECCOMP_ARCH_SUPPORTS=y
BR2_PACKAGE_LIBSIGSEGV_ARCH_SUPPORTS=y
BR2_PACKAGE_LIBTASN1=y
BR2_PACKAGE_LIBUNWIND_ARCH_SUPPORTS=y
BR2_PACKAGE_LIBURCU_ARCH_SUPPORTS=y
BR2_PACKAGE_LLVM_ARCH_SUPPORTS=y
BR2_PACKAGE_LLVM_TARGET_ARCH="X86"
BR2_PACKAGE_P11_KIT=y
BR2_PACKAGE_POCO_ARCH_SUPPORTS=y
BR2_PACKAGE_HOST_PROTOBUF_ARCH_SUPPORTS=y
BR2_PACKAGE_PROTOBUF_ARCH_SUPPORTS=y
BR2_PACKAGE_ENCHANT=y
BR2_PACKAGE_ICU=y
BR2_PACKAGE_ICU_CUSTOM_DATA_PATH=""
BR2_PACKAGE_LIBFRIBIDI=y
BR2_PACKAGE_PCRE=y
BR2_PACKAGE_PCRE_UTF=y
BR2_PACKAGE_PCRE_UCP=y
BR2_PACKAGE_PCRE2=y
BR2_PACKAGE_PCRE2_JIT_ARCH_SUPPORTS=y
BR2_PACKAGE_BITCOIN_ARCH_SUPPORTS=y
BR2_PACKAGE_QEMU_ARCH_SUPPORTS_TARGET=y
BR2_PACKAGE_XMRIG_ARCH_SUPPORTS=y
BR2_PACKAGE_XUTIL_UTIL_MACROS=y
BR2_PACKAGE_Z3_ARCH_SUPPORTS=y
BR2_PACKAGE_HAPROXY_ARCH_SUPPORTS=y
BR2_PACKAGE_IFUPDOWN_SCRIPTS=y
BR2_PACKAGE_MONGREL2_LIBC_SUPPORTS=y
BR2_PACKAGE_XENOMAI_COBALT_ARCH_SUPPORTS=y
BR2_PACKAGE_URANDOM_SCRIPTS=y
BR2_PACKAGE_GNUPG2_DEPENDS=y
BR2_PACKAGE_GNUPG2=y
BR2_PACKAGE_AUDIT_ARCH_SUPPORTS=y
BR2_PACKAGE_EFIVAR_ARCH_SUPPORTS=y
BR2_PACKAGE_INITSCRIPTS=y
BR2_PACKAGE_LIBVIRT_ARCH_SUPPORTS=y
BR2_PACKAGE_MAKEDUMPFILE_ARCH_SUPPORTS=y
BR2_PACKAGE_OPENVMTOOLS_ARCH_SUPPORTS=y
BR2_PACKAGE_SYSTEMD_ARCH_SUPPORTS=y
BR2_PACKAGE_SYSTEMD_BOOTCHART_ARCH_SUPPORTS=y
BR2_PACKAGE_UTIL_LINUX=y
BR2_PACKAGE_UTIL_LINUX_LIBUUID=y
BR2_PACKAGE_XVISOR_ARCH_SUPPORTS=y
```
